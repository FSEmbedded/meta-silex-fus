## conf/layer.conf
```bitbake
# We have a conf and classes directory, add to BBPATH
BBPATH .= ":${LAYERDIR}"

# We have recipes-* directories, add to BBFILES
BBFILES += "${LAYERDIR}/recipes-*/*/*.bb \
            ${LAYERDIR}/recipes-*/*/*.bbappend"

BBFILE_COLLECTIONS += "meta-silex-fus"
BBFILE_PATTERN_meta-silex-fus = "^${LAYERDIR}/"
BBFILE_PRIORITY_meta-silex-fus = "10"

LAYERDEPENDS_meta-silex-fus = "core"
LAYERSERIES_COMPAT_meta-silex-fus = "kirkstone"

MACHINE_ESSENTIAL_EXTRA_RRECOMMENDS:fsimx6sx += "silex-wlanbt-fs-firmware"
MACHINE_ESSENTIAL_EXTRA_RRECOMMENDS:fsimx6sx += "silex-wlanbt-fs"

MACHINE_ESSENTIAL_EXTRA_RRECOMMENDS:fsimx6ul += "silex-wlanbt-fs-firmware"
MACHINE_ESSENTIAL_EXTRA_RRECOMMENDS:fsimx6ul += "silex-wlanbt-fs"

PREFERRED_RPROVIDER_wireless-regdb-static =  "silex-wlanbt-fs-firmware"
```
